## meta-blue/conf/layer.conf
```bitbake
# meta-blue layer - blueprint for the product BSP build.

BBPATH .= ":${LAYERDIR}"

BBFILES += "${LAYERDIR}/recipes-*/*/*.bb \
            ${LAYERDIR}/recipes-*/*/*.bbappend"

BBFILE_COLLECTIONS += "meta-blue"
BBFILE_PATTERN_meta-blue = "^${LAYERDIR}/"
BBFILE_PRIORITY_meta-blue = "10"

LAYERSERIES_COMPAT_meta-blue = "kirkstone scarthgap styhead"
LAYERDEPENDS_meta-blue = "core"
```
